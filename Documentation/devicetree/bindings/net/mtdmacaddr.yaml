## arch/arm/mach-iproc/Kconfig
```kconfig
menuconfig ARCH_XGS_IPROC
	bool "Broadcom XGS iProc Support" if ARCH_MULTI_V7
	select HAVE_ARM_TWD if SMP
	select HAVE_ARM_SCU if SMP
	select ARM_GLOBAL_TIMER
	select ARM_GIC
	select ARCH_REQUIRE_GPIOLIB
	select CACHE_L2X0
	select ARM_AMBA
	select ARCH_SUPPORTS_BIG_ENDIAN
	select CPU_ENDIAN_BE8 if CPU_BIG_ENDIAN
	select ARM_ERRATA_754322
	select ARM_ERRATA_764369 if SMP
	select ARM_ERRATA_775420
	help
	  This enables support for Broadcom XGS iProc based SoC chips

if ARCH_XGS_IPROC

comment	"XGS iProc SoC based Machine types"

choice
	prompt "XGS iProc SoC based Machine types"
	default ML66_NPU_IPROC_PLATFORM

config XGS_IPROC_ARM32_PLATFORM
	bool "Support all XGS iProc ARM32 platforms"
	help
	  Support for all XGS iProc ARM32 platforms.

config MACH_HX4
	bool "Support Broadcom Helix4 bring-up board"
	help
	  Support for the Broadcom Helix4 bring-up board.

config MACH_HR2
	bool "Support Broadcom Hurricane2 bring-up board"
	help
	  Support for the Broadcom Hurricane2 bring-up board.

config MACH_KT2
	bool "Support Broadcom Katana2 bring-up board"
	help
	  Support for the Broadcom Katana2 bring-up board.

config MACH_NPU1003
	bool "Support Ericsson ML66 NPU1003 bring-up board"
	help
	  Support for the Ericsson ML66 NPU1003 bring-up board.

config MACH_GH
	bool "Support Broadcom Greyhound bring-up board"
	help
	  Support for the Broadcom Greyhound bring-up board.

config MACH_SB2
	bool "Support Broadcom Saber2 bring-up board"
	help
	  Support for the Broadcom Saber2 bring-up board.

config MACH_HR3
	bool "Support Broadcom Hurricane3 bring-up board"
	help
	  Support for the Broadcom Hurricane3 bring-up board.

config MACH_GH2
	bool "Support Broadcom Greyhound2 bring-up board"
	help
	  Support for the Broadcom Greyhound2 bring-up board.

config MACH_WH2
	bool "Support Broadcom wolfhound2 bring-up board"
	help
	  Support for the Broadcom Wolfhound2 bring-up board.

config ML66_NPU_IPROC_PLATFORM
	bool "Support all ML66 NPU iProc ARM32 platforms"
	help
	  Support for all ML66 NPU iProc ARM32 platforms.

config MACH_NPU1003
	bool "Support Ericsson ML66 NPU1003 bring-up board"
	help
	  Support for the Ericsson ML66 NPU1003 bring-up board.

config MACH_IPROC_EMULATION
	bool "Support iProc emulation"
	help
	  Support for the iProc emulation.

endchoice

endif
```

## arch/arm/mach-keystone/Kconfig
```kconfig
config ARCH_KEYSTONE
	bool "Texas Instruments Keystone Devices"
	depends on ARCH_MULTI_V7
	select ARM_GIC
	select HAVE_ARM_ARCH_TIMER
	select KEYSTONE_TIMER
	select ARCH_HAS_RESET_CONTROLLER
	select ARM_ERRATA_798181 if SMP
	select COMMON_CLK_KEYSTONE
	select ARCH_SUPPORTS_BIG_ENDIAN
	select ZONE_DMA if ARM_LPAE
	select PINCTRL
	select PM_GENERIC_DOMAINS if PM
	select MIGHT_HAVE_PCI
	select PCI_DOMAINS if PCI
	select TI_KEYSTONE
	select ARCH_REQUIRE_GPIOLIB
	select HAS_RAPIDIO
	help
	Support for boards based on the Texas Instruments Keystone family of
	SoCs.

if ARCH_KEYSTONE
	config TI_KEYSTONE
	bool

choice
	prompt "TI Keystone based board selection"
	default TI_K2EVM

config TI_K2EVM
	bool "TI Keystone Evaluation Module"
	help
	Select this to build a kernel for any TI Keystone Evaluation Board

config FSM4_K2
	bool "NOKIA FSM4 Keystone based board"
	select OF_DYNAMIC
	select REGMAP
	select REGMAP_I2C
	help
	Select this to build a kernel for FSM4 project TI Keystone SoC

endchoice
endif
```

## arch/arm/mach-puma/Kconfig
```kconfig
config ARCH_PUMA
	select CPU_V6
	select DEBUG_UNCOMPRESS
	select COMMON_CLK
	select GENERIC_CLOCKEVENTS
	select IRQ_DOMAIN
if ARCH_PUMA

choice
    prompt "PUMA platform type"
    default MACH_SCMB

config MACH_SCMB
    select MTD_NAND_PUMA
    bool "PT1.5 SCMB"
    help
      Support for PT1.5 Single Carrier Modem Board, mounting PUMA1 platform

config MACH_SCMB_DT
        bool "Generic PUMA support using device tree"
	select CLKSRC_OF
        select USE_OF
	select SERIAL_OF_PLATFORM
	select PROC_DEVICETREE
	select MTD_PHYSMAP_OF
	select MTD_NAND_PUMA
endchoice

choice
    prompt "PUMA Clock Speed"
    default PUMA_CLOCK_HIGH

config PUMA_CLOCK_HIGH
    bool "High Speed Clock: 400MHz"

config PUMA_CLOCK_LOW
    bool "Low Speed Clock: 300MHz"

endchoice

config PUMA1_DEBUG_UART
        int "PUMA1 UART to use for low-level debug"
        default 0
        help
          Choose the UART on which kernel low-level debug messages should be
          output.
endif
```

## arch/arm64/boot/dts/broadcom/helix5/helix5.its
```
/dts-v1/;

/ {
	description = "Linux kernel and FDT blob";
	#address-cells = <1>;

	images {
		kernel_1 {
			description = "Broadcom iProc Linux";
			data = /incbin/("../../../Image.gz");
			type = "kernel";
			arch = "arm64";
			os = "linux";
			compression = "gzip";
			load = <0x61080000>;
			entry = <0x61080000>;
			hash_1 {
				algo = "crc32";
			};
		};

		fdt_1 {
			description = "Flattened Device Tree blob - bcm956370.dtb";
			data = /incbin/("./bcm956370.dtb");
			type = "flat_dt";
			arch = "arm64";
			compression = "none";
			load = <0x61000000>;
			hash_1 {
				algo = "crc32";
			};
		};
	};

	configurations {
		default = "conf_1";
		conf_1 {
			description = "Boot Linux kernel with FDT blob ";
			kernel = "kernel_1";
			fdt = "fdt_1";
		};
	};
};
```

## arch/arm64/boot/dts/broadcom/xgs-iproc.its
```
/dts-v1/;

/ {
	description = "Linux kernel and FDT blob";
	#address-cells = <2>;

	images {
		kernel_1 {
			description = "Broadcom iProc Linux";
			data = /incbin/("../../Image.gz");
			type = "kernel";
			arch = "arm64";
			os = "linux";
			compression = "gzip";
			load = <0x0 0x61080000>;
			entry = <0x0 0x61080000>;
			hash_1 {
				algo = "crc32";
			};
		};

		fdt_hx5 {
			description = "Helix5 Device Tree blob - bcm956370.dtb";
			data = /incbin/("./helix5/bcm956370.dtb");
			type = "flat_dt";
			arch = "arm64";
			compression = "none";
			load = <0x0 0x61000000>;
			hash_1 {
				algo = "crc32";
			};
		};

		fdt_hr4 {
			description = "Hurricane4 Device Tree blob - bcm956275.dtb";
			data = /incbin/("./hurricane4/bcm956275.dtb");
			type = "flat_dt";
			arch = "arm64";
			compression = "none";
			load = <0x0 0x61000000>;
			hash_1 {
				algo = "crc32";
			};
		};
	};

	configurations {
		default = "hx5";
		/* use "bootm 0x64000000#hx5" for booting Helix5 */
		hx5 {
			description = "Boot Linux kernel with Helix5 FDT blob ";
			kernel = "kernel_1";
			fdt = "fdt_hx5";
		};
		hr4 {
			description = "Boot Linux kernel with Hurricane4 FDT blob ";
			kernel = "kernel_1";
			fdt = "fdt_hr4";
		};
	};
};
```

## arch/arm64/configs/ebb8104_defconfig
```kconfig
CONFIG_SYSVIPC=y
CONFIG_POSIX_MQUEUE=y
CONFIG_AUDIT=y
CONFIG_NO_HZ_FULL=y
CONFIG_NO_HZ_FULL_ALL=y
CONFIG_HIGH_RES_TIMERS=y
CONFIG_BSD_PROCESS_ACCT=y
CONFIG_BSD_PROCESS_ACCT_V3=y
CONFIG_TASKSTATS=y
CONFIG_TASK_DELAY_ACCT=y
CONFIG_TASK_XACCT=y
CONFIG_TASK_IO_ACCOUNTING=y
CONFIG_RCU_EXPERT=y
CONFIG_IKCONFIG=y
CONFIG_IKCONFIG_PROC=y
CONFIG_LOG_BUF_SHIFT=14
CONFIG_MEMCG=y
CONFIG_MEMCG_SWAP=y
CONFIG_BLK_CGROUP=y
CONFIG_CGROUP_PIDS=y
CONFIG_CGROUP_HUGETLB=y
CONFIG_CPUSETS=y
CONFIG_CGROUP_DEVICE=y
CONFIG_CGROUP_CPUACCT=y
CONFIG_CGROUP_PERF=y
CONFIG_USER_NS=y
CONFIG_SCHED_AUTOGROUP=y
CONFIG_BLK_DEV_INITRD=y
CONFIG_KALLSYMS_ALL=y
# CONFIG_COMPAT_BRK is not set
CONFIG_PROFILING=y
CONFIG_JUMP_LABEL=y
CONFIG_MODULES=y
CONFIG_MODULE_UNLOAD=y
# CONFIG_IOSCHED_DEADLINE is not set
CONFIG_ARCH_SPRD=y
CONFIG_ML66_OCTEONTX_PLATFORM=y
CONFIG_ARCH_VEXPRESS=y
CONFIG_PCI=y
CONFIG_PCI_IOV=y
CONFIG_PCI_HISI=y
CONFIG_PCI_HOST_GENERIC=y
CONFIG_PCI_HOST_THUNDER_PEM=y
CONFIG_PCI_HOST_THUNDER_ECAM=y
CONFIG_ARM64_64K_PAGES=y
CONFIG_ARM64_VA_BITS_48=y
CONFIG_SCHED_MC=y
CONFIG_NR_CPUS=96
CONFIG_KSM=y
CONFIG_TRANSPARENT_HUGEPAGE=y
CONFIG_CMA=y
CONFIG_SECCOMP=y
CONFIG_KEXEC=y
CONFIG_XEN=y
# CONFIG_ARM64_UAO is not set
# CONFIG_CORE_DUMP_DEFAULT_ELF_HEADERS is not set
CONFIG_CPU_IDLE_GOV_MENU=y
CONFIG_ARM_CPUIDLE=y
CONFIG_NET=y
CONFIG_PACKET=y
CONFIG_UNIX=y
CONFIG_INET=y
CONFIG_IP_MULTICAST=y
CONFIG_IP_PNP=y
CONFIG_IP_PNP_DHCP=y
CONFIG_IP_PNP_BOOTP=y
# CONFIG_IPV6 is not set
CONFIG_NETFILTER=y
CONFIG_NF_CONNTRACK=m
CONFIG_NF_CONNTRACK_EVENTS=y
# CONFIG_NF_CT_PROTO_DCCP is not set
# CONFIG_NF_CT_PROTO_SCTP is not set
# CONFIG_NF_CT_PROTO_UDPLITE is not set
CONFIG_NETFILTER_XT_TARGET_CHECKSUM=m
CONFIG_NETFILTER_XT_TARGET_LOG=m
CONFIG_NETFILTER_XT_MATCH_ADDRTYPE=m
CONFIG_NETFILTER_XT_MATCH_CONNTRACK=m
CONFIG_NF_CONNTRACK_IPV4=m
CONFIG_IP_NF_IPTABLES=m
CONFIG_IP_NF_FILTER=m
CONFIG_IP_NF_TARGET_REJECT=m
CONFIG_IP_NF_NAT=m
CONFIG_IP_NF_TARGET_MASQUERADE=m
CONFIG_IP_NF_MANGLE=m
CONFIG_BRIDGE=y
CONFIG_BRIDGE_VLAN_FILTERING=y
CONFIG_VLAN_8021Q=y
CONFIG_VLAN_8021Q_GVRP=y
CONFIG_VLAN_8021Q_MVRP=y
CONFIG_BPF_JIT=y
CONFIG_CFG80211=m
CONFIG_MAC80211=m
CONFIG_NET_9P=y
CONFIG_UEVENT_HELPER_PATH="/sbin/hotplug"
CONFIG_DEVTMPFS=y
CONFIG_DEVTMPFS_MOUNT=y
CONFIG_MTD=y
CONFIG_MTD_M25P80=y
CONFIG_MTD_SPI_NOR=y
CONFIG_BLK_DEV_LOOP=y
# CONFIG_XEN_BLKDEV_FRONTEND is not set
CONFIG_BLK_DEV_NVME=y
# CONFIG_SCSI_PROC_FS is not set
CONFIG_BLK_DEV_SD=y
CONFIG_SCSI_SAS_ATA=y
CONFIG_SCSI_HISI_SAS=y
CONFIG_MEGARAID_NEWGEN=y
CONFIG_MEGARAID_MM=y
CONFIG_MEGARAID_MAILBOX=y
CONFIG_MEGARAID_LEGACY=y
CONFIG_MEGARAID_SAS=y
CONFIG_SCSI_MPT2SAS=y
CONFIG_ATA=y
CONFIG_SATA_AHCI=y
CONFIG_SATA_AHCI_PLATFORM=y
CONFIG_AHCI_CEVA=y
CONFIG_AHCI_XGENE=y
CONFIG_AHCI_QORIQ=y
CONFIG_SATA_SIL24=y
CONFIG_SATA_MV=y
CONFIG_SATA_SIL=y
CONFIG_SATA_SIS=y
CONFIG_PATA_MARVELL=y
CONFIG_PATA_PLATFORM=y
CONFIG_PATA_OF_PLATFORM=y
CONFIG_NETDEVICES=y
CONFIG_TUN=y
CONFIG_AMD_XGBE=y
CONFIG_MACB=y
CONFIG_THUNDER_NIC_PF=y
CONFIG_THUNDER_NIC_VF=y
CONFIG_HNS_DSAF=y
CONFIG_HNS_ENET=y
CONFIG_E100=y
CONFIG_E1000=y
CONFIG_E1000E=y
CONFIG_IGB=y
CONFIG_IGBVF=y
CONFIG_IXGB=y
CONFIG_IXGBE=y
CONFIG_IXGBEVF=y
CONFIG_I40E=y
CONFIG_I40EVF=y
CONFIG_FM10K=y
CONFIG_SKY2=y
CONFIG_MLX4_EN=y
CONFIG_MLX5_CORE=y
CONFIG_MLX5_CORE_EN=y
CONFIG_MLXSW_CORE=y
# CONFIG_MLXSW_PCI is not set
CONFIG_8139CP=y
CONFIG_8139TOO=y
CONFIG_8139TOO_TUNE_TWISTER=y
CONFIG_8139TOO_8129=y
CONFIG_R8169=y
CONFIG_SMC91X=y
CONFIG_SMSC911X=y
CONFIG_MDIO_BITBANG=y
CONFIG_AQUANTIA_PHY=y
CONFIG_BCM7XXX_PHY=y
CONFIG_BCM87XX_PHY=y
CONFIG_BROADCOM_PHY=y
CONFIG_MARVELL_PHY=y
CONFIG_MICREL_PHY=y
CONFIG_REALTEK_PHY=m
CONFIG_VITESSE_PHY=y
CONFIG_PPP=y
CONFIG_PPP_BSDCOMP=m
CONFIG_PPP_DEFLATE=m
CONFIG_PPP_MPPE=y
CONFIG_PPP_MULTILINK=y
CONFIG_PPPOE=m
CONFIG_PPP_ASYNC=m
CONFIG_PPP_SYNC_TTY=m
# CONFIG_RTL_CARDS is not set
# CONFIG_XEN_NETDEV_FRONTEND is not set
CONFIG_INPUT_MOUSEDEV=y
CONFIG_INPUT_MOUSEDEV_PSAUX=y
CONFIG_INPUT_EVDEV=y
CONFIG_KEYBOARD_GPIO=y
CONFIG_INPUT_MISC=y
# CONFIG_SERIO_SERPORT is not set
CONFIG_SERIO_AMBAKMI=y
CONFIG_VT_HW_CONSOLE_BINDING=y
CONFIG_LEGACY_PTY_COUNT=16
CONFIG_SERIAL_8250=y
CONFIG_SERIAL_8250_CONSOLE=y
CONFIG_SERIAL_8250_DW=y
CONFIG_SERIAL_OF_PLATFORM=y
CONFIG_SERIAL_AMBA_PL011=y
CONFIG_SERIAL_AMBA_PL011_CONSOLE=y
CONFIG_SERIAL_XILINX_PS_UART=y
CONFIG_SERIAL_XILINX_PS_UART_CONSOLE=y
CONFIG_I2C_CHARDEV=y
CONFIG_I2C_MUX=y
CONFIG_I2C_MUX_PCA954x=y
CONFIG_I2C_DESIGNWARE_PLATFORM=y
CONFIG_I2C_THUNDERX=y
CONFIG_I2C_SLAVE=y
CONFIG_SPI=y
CONFIG_SPI_PL022=y
CONFIG_SPI_THUNDERX=y
CONFIG_SPI_SPIDEV=m
CONFIG_GPIO_SYSFS=y
CONFIG_GPIO_DWAPB=y
CONFIG_GPIO_GENERIC_PLATFORM=y
CONFIG_GPIO_PL061=y
CONFIG_GPIO_THUNDERX=y
CONFIG_GPIO_XGENE=y
CONFIG_GPIO_PCA953X=y
CONFIG_GPIO_PCA953X_IRQ=y
CONFIG_POWER_RESET_XGENE=y
CONFIG_POWER_RESET_SYSCON=y
CONFIG_BATTERY_BQ27XXX=y
# CONFIG_HWMON is not set
CONFIG_THERMAL_GOV_POWER_ALLOCATOR=y
CONFIG_THERMAL_EMULATION=y
CONFIG_WATCHDOG=y
CONFIG_ARM_SBSA_WATCHDOG=y
# CONFIG_MFD_VEXPRESS_SYSREG is not set
CONFIG_REGULATOR=y
CONFIG_REGULATOR_FIXED_VOLTAGE=y
CONFIG_REGULATOR_GPIO=y
CONFIG_FB=m
# CONFIG_XEN_FBDEV_FRONTEND is not set
# CONFIG_HID_GENERIC is not set
# CONFIG_HID_A4TECH is not set
# CONFIG_HID_APPLE is not set
# CONFIG_HID_BELKIN is not set
# CONFIG_HID_CHERRY is not set
# CONFIG_HID_CHICONY is not set
# CONFIG_HID_CYPRESS is not set
# CONFIG_HID_EZKEY is not set
# CONFIG_HID_KENSINGTON is not set
# CONFIG_HID_LOGITECH is not set
# CONFIG_HID_MICROSOFT is not set
# CONFIG_HID_MONTEREY is not set
CONFIG_MMC=y
CONFIG_MMC_BLOCK_MINORS=32
CONFIG_MMC_CAVIUM_THUNDERX=y
CONFIG_RTC_CLASS=y
CONFIG_RTC_DRV_DS1307=y
CONFIG_RTC_DRV_DS1307_CENTURY=y
CONFIG_RTC_DRV_DS3232=y
CONFIG_RTC_DRV_EFI=y
CONFIG_RTC_DRV_PL031=y
CONFIG_DMADEVICES=y
CONFIG_PL330_DMA=y
CONFIG_QCOM_HIDMA_MGMT=y
CONFIG_QCOM_HIDMA=y
CONFIG_SYNC_FILE=y
CONFIG_VFIO=y
CONFIG_VFIO_PCI=y
CONFIG_VFIO_PLATFORM=y
# CONFIG_XEN_BALLOON is not set
# CONFIG_XEN_DEV_EVTCHN is not set
# CONFIG_XEN_BACKEND is not set
# CONFIG_XENFS is not set
# CONFIG_XEN_SYS_HYPERVISOR is not set
# CONFIG_XEN_GNTDEV is not set
# CONFIG_XEN_GRANT_DEV_ALLOC is not set
# CONFIG_CLK_SP810 is not set
# CONFIG_CLK_VEXPRESS_OSC is not set
# CONFIG_COMMON_CLK_XGENE is not set
# CONFIG_ARM_ARCH_TIMER_EVTSTREAM is not set
# CONFIG_FSL_ERRATUM_A008585 is not set
CONFIG_ARM_TIMER_SP804=y
CONFIG_MAILBOX=y
CONFIG_ARM_MHU=y
CONFIG_ARM_SMMU=y
CONFIG_PHY_XGENE=y
CONFIG_ARM_SCPI_PROTOCOL=y
CONFIG_ACPI=y
CONFIG_EXT2_FS=y
CONFIG_EXT3_FS=y
CONFIG_EXT4_FS_POSIX_ACL=y
CONFIG_XFS_FS=y
CONFIG_BTRFS_FS=m
CONFIG_BTRFS_FS_POSIX_ACL=y
CONFIG_FANOTIFY=y
CONFIG_FANOTIFY_ACCESS_PERMISSIONS=y
CONFIG_QUOTA=y
CONFIG_AUTOFS4_FS=y
CONFIG_FUSE_FS=m
CONFIG_CUSE=m
CONFIG_OVERLAY_FS=m
CONFIG_VFAT_FS=y
CONFIG_TMPFS=y
CONFIG_HUGETLBFS=y
CONFIG_CONFIGFS_FS=y
CONFIG_EFIVAR_FS=y
CONFIG_SQUASHFS=y
CONFIG_NFS_FS=y
CONFIG_NFS_V4=y
CONFIG_NFS_V4_1=y
CONFIG_NFS_V4_2=y
CONFIG_ROOT_NFS=y
CONFIG_9P_FS=y
CONFIG_NLS_CODEPAGE_437=y
CONFIG_NLS_ISO8859_1=y
CONFIG_VIRTUALIZATION=y
CONFIG_KVM=y
CONFIG_PRINTK_TIME=y
CONFIG_DEBUG_INFO=y
CONFIG_DEBUG_FS=y
CONFIG_MAGIC_SYSRQ=y
CONFIG_DEBUG_KERNEL=y
CONFIG_DETECT_HUNG_TASK=y
# CONFIG_SCHED_DEBUG is not set
# CONFIG_RCU_TRACE is not set
# CONFIG_FTRACE is not set
CONFIG_MEMTEST=y
CONFIG_SECURITY=y
CONFIG_CRYPTO_ECHAINIV=y
CONFIG_CRYPTO_ANSI_CPRNG=y
CONFIG_CRYPTO_USER_API_HASH=y
CONFIG_CRYPTO_USER_API_SKCIPHER=y
CONFIG_CRYPTO_USER_API_RNG=y
CONFIG_CRYPTO_USER_API_AEAD=y
CONFIG_ARM64_CRYPTO=y
CONFIG_CRYPTO_SHA1_ARM64_CE=y
CONFIG_CRYPTO_SHA2_ARM64_CE=y
CONFIG_CRYPTO_GHASH_ARM64_CE=y
CONFIG_CRYPTO_AES_ARM64_CE_CCM=y
CONFIG_CRYPTO_AES_ARM64_CE_BLK=y
CONFIG_CRC_ITU_T=y
CONFIG_CRC7=y
```
