&cpu0 {
      i-cache-sets = <0x40>;
      i-cache-size = <0x8000>;
      i-cache-block-size = <0x40>;
      cache-stash-id = <0x20>;
      d-cache-sets = <0x40>;
      d-cache-size = <0x8000>;
      d-cache-block-size = <0x40>;

      enable-method = "spin-table";
      cpu-release-addr = <0x0 0xfffffc00>;
};

&cpu1 {
      i-cache-sets = <0x40>;
      i-cache-size = <0x8000>;
      i-cache-block-size = <0x40>;
      cache-stash-id = <0x24>;
      d-cache-sets = <0x40>;
      d-cache-size = <0x8000>;
      d-cache-block-size = <0x40>;

      enable-method = "spin-table";
      cpu-release-addr = <0x0 0xfffffc40>;
};

&cpu2 {
      i-cache-sets = <0x40>;
      i-cache-size = <0x8000>;
      i-cache-block-size = <0x40>;
      cache-stash-id = <0x28>;
      d-cache-sets = <0x40>;
      d-cache-size = <0x8000>;
      d-cache-block-size = <0x40>;

      enable-method = "spin-table";
      cpu-release-addr = <0x0 0xfffffc80>;
};

&cpu3 {
      i-cache-sets = <0x40>;
      i-cache-size = <0x8000>;
      i-cache-block-size = <0x40>;
      cache-stash-id = <0x2c>;
      d-cache-sets = <0x40>;
      d-cache-size = <0x8000>;
      d-cache-block-size = <0x40>;

      enable-method = "spin-table";
      cpu-release-addr = <0x0 0xfffffcc0>;
};
