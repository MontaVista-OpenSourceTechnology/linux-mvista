## drivers/staging/gpio/Kconfig
```kconfig
# SPDX-License-Identifier: GPL-2.0
#
# GPIO infrastructure and drivers
#
menu "GPIO expanders"

config GPIO_PI4IOE5V6408
	tristate "Pericom PI4IOE5V6408 I2C GPIO Expander"
	select REGMAP_I2C
	depends on I2C
	help
	  Say yes here to enable the Pericom PI4IOE5V6408 GPIO Expander

config GPIO_TRIZEPS8_MCU
	tristate "Trizeps8 MCU GPIO Expander"
	depends on MFD_SECO_TRIZEPS8_MCU
	help
	  Say yes here to enable the Trizeps8 MCU based GPIO Expander


endmenu
```

## drivers/staging/mfd/Kconfig
```kconfig
# SPDX-License-Identifier: GPL-2.0

menuconfig MFD_SECO_TRIZEPS8_MCU
	bool "SECO Trizeps8 MCU Multifunction device driver"
	help
	  Say yes here to enable the Trizeps8 MCU Multifunction device driver
```

## drivers/video/fbdev/xylon/Kconfig
```kconfig
menuconfig FB_XYLON
	tristate "Xylon logiCVC frame buffer support"
	depends on FB
	default n
	select FB_CFB_FILLRECT
	select FB_CFB_COPYAREA
	select FB_CFB_IMAGEBLIT
	select FB_MODE_HELPERS
	select VIDEOMODE_HELPERS
	help
	  Choose this option if you want to use the Xylon logiCVC as frame
	  buffer device. Without the support of PCI & AGP.

config FB_XYLON_PIXCLK
	bool "Xylon logiCVC pixel clock"
	depends on FB_XYLON
	default n
	help
	  logiCVC pixel clock generated from:
	  - External generator not controllable by Xylon framebuffer driver
	    This is default selection.
	  - Generators controllable by Xylon framebuffer driver

config FB_XYLON_PIXCLK_LOGICLK
	bool "Xylon logiCLK pixel clock generator"
	depends on FB_XYLON && FB_XYLON_PIXCLK
	default n
	select COMMON_CLK_LOGICLK
	help
	  Support for controlling pixel clock generation from
	  Xylon logiCLK FGPA IP core.

config FB_XYLON_PIXCLK_SI570
	bool "Si570 pixel clock generator"
	depends on FB_XYLON && FB_XYLON_PIXCLK
	default n
	select I2C
	select COMMON_CLK_SI570
	help
	  Support for controlling pixel clock generation from
	  Si570 clock generator.

menuconfig FB_XYLON_MISC
	bool "Xylon logiCVC frame buffer miscellaneous support"
	depends on FB_XYLON
	default n
	help
	  Choose this option if you want to use the Xylon logiCVC with
	  miscellaneous device functionality for various improvements.
	  Currently supported:
	  - ADV7511 HDMI transmitter

config FB_XYLON_MISC_ADV7511
	bool "Xylon logiCVC frame buffer ADV7511"
	depends on FB_XYLON_MISC && MEDIA_SUPPORT && MEDIA_CONTROLLER
	select FB_MODE_HELPERS
	default n
	---help---
	  Support for ADV7511 HDMI transmitter. logiCVC uses provided EDID for
	  automatic video mode configuration.
```
