## arch/arm64/configs/iproc_a72_be_defconfig
```kconfig
CONFIG_CROSS_COMPILE="$CROSS_COMPILE"
CONFIG_SYSVIPC=y
# CONFIG_FHANDLE is not set
CONFIG_USELIB=y
CONFIG_NO_HZ=y
CONFIG_IKCONFIG=y
CONFIG_IKCONFIG_PROC=y
CONFIG_LOG_BUF_SHIFT=16
CONFIG_LOG_CPU_MAX_BUF_SHIFT=13
CONFIG_SYSCTL_SYSCALL=y
# CONFIG_ELF_CORE is not set
# CONFIG_BASE_FULL is not set
# CONFIG_EPOLL is not set
# CONFIG_SIGNALFD is not set
# CONFIG_TIMERFD is not set
# CONFIG_EVENTFD is not set
# CONFIG_SHMEM is not set
# CONFIG_AIO is not set
CONFIG_EMBEDDED=y
# CONFIG_SLUB_DEBUG is not set
# CONFIG_COMPAT_BRK is not set
CONFIG_MODULES=y
CONFIG_MODULE_UNLOAD=y
CONFIG_PARTITION_ADVANCED=y
CONFIG_ARCH_XGS_IPROC=y
CONFIG_PCI=y
CONFIG_PCIEPORTBUS=y
CONFIG_PCIE_XGS_IPROC=y
CONFIG_PCIE_IPROC_MSI=y
CONFIG_CPU_BIG_ENDIAN=y
CONFIG_NR_CPUS=4
CONFIG_PREEMPT=y
CONFIG_HZ_100=y
# CONFIG_COMPACTION is not set
CONFIG_CMA=y
CONFIG_CMA_DEBUG=y
CONFIG_CMDLINE="console=ttyS0,115200n8 maxcpus=2 mem=496M"
CONFIG_NET=y
CONFIG_PACKET=y
CONFIG_UNIX=y
CONFIG_INET=y
CONFIG_IP_MULTICAST=y
CONFIG_IP_ADVANCED_ROUTER=y
CONFIG_IP_MULTIPLE_TABLES=y
CONFIG_IP_PNP=y
CONFIG_IP_PNP_DHCP=y
CONFIG_IP_PNP_BOOTP=y
# CONFIG_INET_XFRM_MODE_TRANSPORT is not set
# CONFIG_INET_XFRM_MODE_TUNNEL is not set
# CONFIG_INET_XFRM_MODE_BEET is not set
# CONFIG_INET_DIAG is not set
CONFIG_IPV6_TUNNEL=y
CONFIG_NETFILTER=y
CONFIG_BRIDGE_NETFILTER=y
CONFIG_NETFILTER_NETLINK_QUEUE=y
CONFIG_NETFILTER_NETLINK_LOG=y
CONFIG_NF_CONNTRACK=y
# CONFIG_NF_CT_PROTO_DCCP is not set
# CONFIG_NF_CT_PROTO_SCTP is not set
# CONFIG_NF_CT_PROTO_UDPLITE is not set
CONFIG_NF_CONNTRACK_FTP=y
CONFIG_NF_CONNTRACK_TFTP=y
CONFIG_NETFILTER_XT_MARK=y
CONFIG_NETFILTER_XT_TARGET_CT=y
CONFIG_NETFILTER_XT_TARGET_TCPMSS=y
CONFIG_NETFILTER_XT_MATCH_CONNMARK=y
CONFIG_NETFILTER_XT_MATCH_CONNTRACK=y
CONFIG_NETFILTER_XT_MATCH_HELPER=y
CONFIG_NETFILTER_XT_MATCH_STATE=y
CONFIG_NETFILTER_XT_MATCH_TCPMSS=y
CONFIG_NF_CONNTRACK_IPV4=y
CONFIG_IP_NF_IPTABLES=y
CONFIG_IP_NF_MATCH_AH=y
CONFIG_IP_NF_MATCH_ECN=y
CONFIG_IP_NF_MATCH_TTL=y
CONFIG_IP_NF_FILTER=y
CONFIG_IP_NF_TARGET_REJECT=y
CONFIG_IP_NF_MANGLE=y
CONFIG_IP_NF_TARGET_ECN=y
CONFIG_IP_NF_TARGET_TTL=y
CONFIG_IP_NF_RAW=y
CONFIG_IP_NF_ARPTABLES=y
CONFIG_IP_NF_ARPFILTER=y
CONFIG_IP_NF_ARP_MANGLE=y
CONFIG_NF_CONNTRACK_IPV6=y
CONFIG_IP6_NF_IPTABLES=y
CONFIG_IP6_NF_MATCH_RPFILTER=y
CONFIG_IP6_NF_MATCH_RT=y
CONFIG_IP6_NF_FILTER=y
CONFIG_IP6_NF_TARGET_REJECT=y
CONFIG_IP6_NF_MANGLE=y
CONFIG_IP6_NF_RAW=y
CONFIG_BRIDGE=y
CONFIG_VLAN_8021Q=y
CONFIG_VLAN_8021Q_GVRP=y
# CONFIG_WIRELESS is not set
CONFIG_UEVENT_HELPER_PATH="/sbin/mdev"
CONFIG_DEVTMPFS=y
CONFIG_DEVTMPFS_MOUNT=y
CONFIG_DMA_CMA=y
CONFIG_CMA_SIZE_MBYTES=32
CONFIG_MTD=y
CONFIG_MTD_TESTS=m
CONFIG_MTD_CMDLINE_PARTS=y
CONFIG_MTD_BLOCK=y
CONFIG_MTD_CFI=y
CONFIG_MTD_JEDECPROBE=y
CONFIG_MTD_CFI_ADV_OPTIONS=y
CONFIG_MTD_CFI_LE_BYTE_SWAP=y
CONFIG_MTD_CFI_INTELEXT=y
CONFIG_MTD_CFI_AMDSTD=y
CONFIG_MTD_CFI_STAA=y
CONFIG_MTD_M25P80=y
CONFIG_MTD_NAND=y
CONFIG_MTD_NAND_BRCMNAND=y
CONFIG_MTD_SPI_NOR=y
# CONFIG_MTD_SPI_NOR_USE_4K_SECTORS is not set
CONFIG_MTD_UBI=y
CONFIG_BLK_DEV_RAM=y
CONFIG_EEPROM_AT24=y
CONFIG_SCSI=y
CONFIG_BLK_DEV_SD=y
CONFIG_CHR_DEV_ST=y
CONFIG_CHR_DEV_SG=y
CONFIG_SCSI_CONSTANTS=y
CONFIG_SCSI_LOGGING=y
CONFIG_NETDEVICES=y
CONFIG_BONDING=y
CONFIG_TIGON3=y
# CONFIG_BGMAC_PLATFORM is not set
CONFIG_APM=y
CONFIG_MDIO_XGS_IPROC=y
CONFIG_E1000E=y
CONFIG_IGB=y
CONFIG_IGB_HWMON=y
CONFIG_BROADCOM_PHY=y
CONFIG_XGS_IPROC_SERDES=y
# CONFIG_WLAN is not set
# CONFIG_INPUT is not set
CONFIG_SERIO_LIBPS2=y
# CONFIG_VT is not set
# CONFIG_LEGACY_PTYS is not set
CONFIG_SERIAL_8250=y
CONFIG_SERIAL_8250_CONSOLE=y
CONFIG_SERIAL_8250_NR_UARTS=2
CONFIG_SERIAL_8250_RUNTIME_UARTS=2
CONFIG_SERIAL_8250_EXTENDED=y
CONFIG_SERIAL_8250_SHARE_IRQ=y
CONFIG_SERIAL_8250_DETECT_IRQ=y
CONFIG_SERIAL_8250_RSA=y
CONFIG_SERIAL_8250_DW=y
CONFIG_SERIAL_OF_PLATFORM=y
CONFIG_HW_RANDOM=y
CONFIG_HW_RANDOM_XGS_IPROC_RNG=y
CONFIG_I2C=y
# CONFIG_I2C_COMPAT is not set
CONFIG_I2C_CHARDEV=y
# CONFIG_I2C_HELPER_AUTO is not set
CONFIG_SPI=y
CONFIG_SPI_PL022=y
CONFIG_GPIOLIB=y
CONFIG_GPIO_SYSFS=y
CONFIG_WATCHDOG=y
CONFIG_ARM_SP805_WATCHDOG=y
# CONFIG_VGA_ARB is not set
CONFIG_USB=y
CONFIG_USB_ANNOUNCE_NEW_DEVICES=y
CONFIG_USB_DYNAMIC_MINORS=y
CONFIG_USB_XHCI_HCD=y
CONFIG_USB_XHCI_PLATFORM=y
CONFIG_USB_STORAGE=y
CONFIG_USB_XGS_IPROC_DRD=y
CONFIG_USB_GADGET=y
CONFIG_USB_BDC_UDC=y
CONFIG_USB_ETH=m
CONFIG_USB_ETH_RNDIS=y
CONFIG_USB_ETH_EEM=y
CONFIG_USB_G_SERIAL=m
CONFIG_MMC=y
CONFIG_MMC_SDHCI=y
CONFIG_DMADEVICES=y
CONFIG_DMADEVICES_DEBUG=y
CONFIG_DMADEVICES_VDEBUG=y
CONFIG_PL330_DMA=y
# CONFIG_COMMON_CLK_XGENE is not set
CONFIG_ACPI=y
CONFIG_EXT2_FS=y
CONFIG_EXT3_FS=y
# CONFIG_DNOTIFY is not set
CONFIG_AUTOFS4_FS=y
CONFIG_MSDOS_FS=y
CONFIG_VFAT_FS=y
CONFIG_NTFS_FS=y
# CONFIG_PROC_PAGE_MONITOR is not set
CONFIG_JFFS2_FS=y
CONFIG_UBIFS_FS=y
CONFIG_NFS_FS=y
CONFIG_NFS_V3_ACL=y
CONFIG_NFS_V4=y
CONFIG_NFS_SWAP=y
CONFIG_ROOT_NFS=y
CONFIG_NFSD=y
CONFIG_NLS_CODEPAGE_437=y
CONFIG_NLS_ASCII=y
CONFIG_NLS_ISO8859_1=y
CONFIG_DEBUG_INFO=y
# CONFIG_ENABLE_WARN_DEPRECATED is not set
# CONFIG_ENABLE_MUST_CHECK is not set
CONFIG_FRAME_WARN=1024
CONFIG_DEBUG_FS=y
CONFIG_MAGIC_SYSRQ=y
# CONFIG_SCHED_DEBUG is not set
CONFIG_RCU_CPU_STALL_TIMEOUT=60
# CONFIG_FTRACE is not set
CONFIG_CRYPTO_RSA=y
CONFIG_CRYPTO_DH=y
CONFIG_CRYPTO_AUTHENC=y
CONFIG_CRYPTO_TEST=m
CONFIG_CRYPTO_CCM=y
CONFIG_CRYPTO_GCM=y
CONFIG_CRYPTO_CBC=y
CONFIG_CRYPTO_ECB=y
CONFIG_CRYPTO_MD5=y
CONFIG_CRYPTO_ARC4=y
CONFIG_CRYPTO_DES=y
CONFIG_CRYPTO_ANSI_CPRNG=m
CONFIG_CRYPTO_DEV_IPROC_PKA=y
CONFIG_ARM64_CRYPTO=y
CONFIG_CRYPTO_SHA512_ARM64=y
CONFIG_CRYPTO_SHA1_ARM64_CE=y
CONFIG_CRYPTO_SHA2_ARM64_CE=y
CONFIG_CRYPTO_GHASH_ARM64_CE=y
CONFIG_CRYPTO_CRC32_ARM64_CE=y
CONFIG_CRYPTO_AES_ARM64_CE_CCM=y
CONFIG_CRYPTO_AES_ARM64_CE_BLK=y
CONFIG_CRYPTO_AES_ARM64_BS=y
```

## drivers/char/vgem/Kconfig
```kconfig
config AGIB_VGEM
       tristate "AGIB VGEM Driver"
       help
         Handles ARM-A15 and C66X CorePacks IPC
	 on Airbus TB4 AGIB board
```

## drivers/hwqueue/Kconfig
```kconfig
#
# Generic HWQUEUE framework
#

# HWQUEUE always gets selected by whoever wants it.
config HWQUEUE
	tristate
	select RING_BUFFER

menu "Hardware Queue drivers"

config HWQUEUE_TEST
	tristate "Hardware Queue test driver"
	depends on HWQUEUE
	help
	  Say y here to enable test code for the hardware queue subsystem

	  If unsure, say N.

config HWQUEUE_KEYSTONE
	tristate "Keystone Hardware Queue device"
	depends on ARCH_KEYSTONE
	default y if ARCH_KEYSTONE
	select HWQUEUE
	help
	  Say y here to support the Keystone Hardware queue device

	  If unsure, say N.

endmenu
```

## drivers/mxc/Kconfig
```kconfig
# drivers/mxc/Kconfig

if ARCH_MXC

menu "MXC support drivers"

source "drivers/mxc/gpu-viv/Kconfig"
source "drivers/mxc/hdmi-cec/Kconfig"
source "drivers/mxc/mipi/Kconfig"

endmenu

endif
```

## drivers/net/ethernet/puma/Kconfig
```kconfig
#
# PUMA NET device configuration
#

config PUMA_NET_TI_CPGMAC
	tristate "PUMA 10/100/1000 EMAC support"
	select PHYLIB
	---help---
	  This driver supports the 10/100/1000 TI CPGMAC For PUMA board.
```

## drivers/net/ethernet/ti/Kconfig
```kconfig
#
# TI device configuration
#

config NET_VENDOR_TI
	bool "Texas Instruments (TI) devices"
	default y
	depends on PCI || EISA || AR7 || ARCH_DAVINCI || ARCH_OMAP2PLUS || ARCH_KEYSTONE
	---help---
	  If you have a network (Ethernet) card belonging to this class, say Y.

	  Note that the answer to this question doesn't directly affect the
	  kernel: saying N will just cause the configurator to skip all
	  the questions about TI devices. If you say Y, you will be asked for
	  your specific card in the following questions.

if NET_VENDOR_TI

config TI_DAVINCI_EMAC
	tristate "TI DaVinci EMAC Support"
	depends on ARM && ( ARCH_DAVINCI || ARCH_OMAP3 ) || COMPILE_TEST
	select TI_DAVINCI_MDIO
	select TI_DAVINCI_CPDMA
	select PHYLIB
	---help---
	  This driver supports TI's DaVinci Ethernet .

	  To compile this driver as a module, choose M here: the module
	  will be called davinci_emac_driver.  This is recommended.

config TI_DAVINCI_MDIO
	tristate "TI DaVinci MDIO Support"
	depends on ARCH_DAVINCI || ARCH_OMAP2PLUS || ARCH_KEYSTONE || COMPILE_TEST
	select PHYLIB
	---help---
	  This driver supports TI's DaVinci MDIO module.

	  To compile this driver as a module, choose M here: the module
	  will be called davinci_mdio.  This is recommended.

config TI_DAVINCI_CPDMA
	tristate "TI DaVinci CPDMA Support"
	depends on ARCH_DAVINCI || ARCH_OMAP2PLUS || COMPILE_TEST
	select GENERIC_ALLOCATOR
	---help---
	  This driver supports TI's DaVinci CPDMA dma engine.

	  To compile this driver as a module, choose M here: the module
	  will be called davinci_cpdma.  This is recommended.

config TI_CPSW_PHY_SEL
	bool
	---help---
	  This driver supports configuring of the phy mode connected to
	  the CPSW.

config TI_CPSW_ALE
	tristate "TI CPSW ALE Support"
	---help---
	  This driver supports TI's CPSW ALE module.

config TI_CPSW
	tristate "TI CPSW Switch Support"
	depends on ARCH_DAVINCI || ARCH_OMAP2PLUS || COMPILE_TEST
	select TI_DAVINCI_CPDMA
	select TI_DAVINCI_MDIO
	select TI_CPSW_PHY_SEL
	select TI_CPSW_ALE
	select MFD_SYSCON
	select REGMAP
	---help---
	  This driver supports TI's CPSW Ethernet Switch.

	  To compile this driver as a module, choose M here: the module
	  will be called cpsw.

config TI_CPTS
	bool "TI Common Platform Time Sync (CPTS) Support"
	depends on TI_CPSW || TI_KEYSTONE_NETCP || TI_KEYSTONE_NET || COMPILE_TEST
	depends on POSIX_TIMERS
	---help---
	  This driver supports the Common Platform Time Sync unit of
	  the CPSW Ethernet Switch and Keystone 2 1g/10g Switch Subsystem.
	  The unit can time stamp PTP UDP/IPv4 and Layer 2 packets, and the
	  driver offers a PTP Hardware Clock.

config TI_CPTS_MOD
	tristate
	depends on TI_CPTS
	default y if TI_CPSW=y || TI_KEYSTONE_NETCP=y || TI_KEYSTONE_NET=y
	select NET_PTP_CLASSIFY
	imply PTP_1588_CLOCK
	default m

config TI_KEYSTONE_NETCP
	tristate "TI Keystone NETCP Core Support"
	select TI_CPSW_ALE
	select TI_DAVINCI_MDIO
	depends on OF
	depends on KEYSTONE_NAVIGATOR_DMA && KEYSTONE_NAVIGATOR_QMSS
	---help---
	  This driver supports TI's Keystone NETCP Core.

	  To compile this driver as a module, choose M here: the module
	  will be called keystone_netcp.

config TI_KEYSTONE_NETCP_ETHSS
	depends on TI_KEYSTONE_NETCP
	tristate "TI Keystone NETCP Ethernet subsystem Support"
	---help---

	  To compile this driver as a module, choose M here: the module
	  will be called keystone_netcp_ethss.

config TI_KEYSTONE_NET
	tristate "TI Keystone Ethernet Support"
	depends on ARCH_KEYSTONE
	default y if ARCH_KEYSTONE
	---help---
	  This driver supports TI's Keystone Ethernet.

	  To compile this driver as a module, choose M here: the module
	  will be called keystone_net.

config TI_KEYSTONE_PA
	tristate "TI Keystone Packet Accelerator Support"
	depends on ARCH_KEYSTONE
	default y if ARCH_KEYSTONE
	---help---
	  This driver supports TI's Keystone Packet Accelerator.

	  To compile this driver as a module, choose M here: the module
	  will be called keystone_pa.

config TI_KEYSTONE_QOS
	tristate "TI Keystone Quality of Service Support"
	depends on ARCH_KEYSTONE
	default y if ARCH_KEYSTONE
	---help---
	  This driver supports TI's Keystone Quality of Service support.

	  To compile this driver as a module, choose M here: the module
	  will be called keystone_qos.

config TI_KEYSTONE_NET_SA
	tristate "TI Keystone inflow Security Accelerator mode Support"
	depends on ARCH_KEYSTONE
	default y if ARCH_KEYSTONE
	---help---
	  This driver supports TI's Keystone inflow Security Accelerator
          mode.

config TLAN
	tristate "TI ThunderLAN support"
	depends on (PCI || EISA)
	---help---
	  If you have a PCI Ethernet network card based on the ThunderLAN chip
	  which is supported by this driver, say Y here.

	  Devices currently supported by this driver are Compaq Netelligent,
	  Compaq NetFlex and Olicom cards.  Please read the file
	  <file:Documentation/networking/tlan.txt> for more details.

	  To compile this driver as a module, choose M here. The module
	  will be called tlan.

	  Please email feedback to <torben.mathiasen@compaq.com>.

config CPMAC
	tristate "TI AR7 CPMAC Ethernet support"
	depends on AR7
	select PHYLIB
	---help---
	  TI AR7 CPMAC Ethernet support

config TI_KEYSTONE_XGE
	tristate "TI Keystone 10Gig Ethernet Support"
	depends on ARCH_KEYSTONE && TI_KEYSTONE_NET
	---help---
	  This driver supports TI's Keystone 10Gig Ethernet.

	  To compile this driver as a module, choose M here: the module
	  will be called keystone_xge.

config TI_KEYSTONE_XGE_MDIO
	tristate "TI Keystone 10GE MDIO Support"
	depends on ARM && ARCH_KEYSTONE
	select PHYLIB
	---help---
	  This driver supports TI's Keystone 10GE MDIO module.

	  To compile this driver as a module, choose M here: the module
	  will be called keystone_xgemdio.  This is recommended.

endif # NET_VENDOR_TI
```

## drivers/rapidio/devices/Kconfig
```kconfig
#
# RapidIO master port configuration
#

config RAPIDIO_TSI721
	tristate "IDT Tsi721 PCI Express SRIO Controller support"
	depends on RAPIDIO && PCIEPORTBUS
	default "n"
	---help---
	  Include support for IDT Tsi721 PCI Express Serial RapidIO controller.

config TI_KEYSTONE_RAPIDIO
       tristate "TI Keystone RapidIO support"
       depends on RAPIDIO && ARCH_KEYSTONE
       default "n"
       ---help---
         This driver supports TI's Keystone RapidIO.

source "drivers/rapidio/devices/lsi/Kconfig"
```

## drivers/rapidio/devices/lsi/Kconfig
```kconfig
config AXXIA_RIO
       bool "LSI Embedded SRIO Controller support"
       depends on RAPIDIO && (ACP || ARCH_AXXIA)
       select SG_SPLIT
       default "n"
       ---help---
         Include support for RapidIO controllers for LSI Axxia
         devices. The Axxia devices with arm (AXM55xx) and
         powerpc (AXM35xx) cores has the serial RapidIO
         controllers.

config RIO_MAINT_WIN_SIZE
       hex "RIO mport maintenance window size"
       depends on RAPIDIO
       default "0x400000"
       ---help---
         Size of RAPIDIO maintenance transaction window.
         If RapidIO LAW size in your platform is less than 0x400000,
         you may use this option to adjust the maintenance transaction
         window accordingly.

config AXXIA_RIO_STAT
       bool "AXXIA RIO driver statistics"
       depends on AXXIA_RIO
       default n
       ---help---
         If you say Y here, you will be able to measure and view
         state and interrupt counters for the Axxia RapidIO
         controller via sysfs. It provides the counters for mbox
         messages. May add a slght cpu overhead.

config AXXIA_RIO_BURST_STAT
       bool "AXXIA RIO driver burst statistics"
       depends on AXXIA_RIO_STAT
       default n
       ---help---
         If you say Y here, the driver will monitor incoming
         bursts of traffic.

config AXXIA_RIO_16B_ID
       bool "RapidIO large common transport system"
       depends on AXXIA_RIO && (ACP && PPC)
       default n
       ---help---
         Say yes here to enable use of 16 bit transport ID otherwise
         transport ID has 8 bits. This is required only for older
         Axxia devices (34xx). And not required for the newer AXM55xx
         devices.

config OB_DME_ENTRY_SIZE
       int "Number of Descriptors per DME for Static allocation"
       depends on AXXIA_RIO
       default "8192"
       ---help---
         Number of Descriptors to allocate for each outbound DME.
```
