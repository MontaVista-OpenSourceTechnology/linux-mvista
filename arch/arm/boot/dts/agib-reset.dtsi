&gpio0 {
	/delete-property/ reg;
	reg = <0x0260bf00 0x10 0x0260bf10 0x28>;
	interrupt-controller;
	#interrupt-cells = <2>;
};

/ {
	aliases {
		gpio0 = &gpio0;
	};

	fsp_reset {
		compatible = "nsn,fsp_reset";
		interrupt-parent = <&gpio0>;
		interrupts = <0x16 0x2>;
	};

};
