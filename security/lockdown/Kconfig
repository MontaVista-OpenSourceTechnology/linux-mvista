## security/lockdown/Kconfig
```kconfig
config LOCK_DOWN_KERNEL
	bool "Allow the kernel to be 'locked down'"
	help
	  Allow the kernel to be locked down under certain circumstances, for
	  instance if UEFI secure boot is enabled.  Locking down the kernel
	  turns off various features that might otherwise allow access to the
	  kernel image (eg. setting MSR registers).
```
