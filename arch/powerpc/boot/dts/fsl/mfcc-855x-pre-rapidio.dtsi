/ {
        rio: rapidio@ffe0c0000 {
                status = "disabled";

                reg = <0xf 0xfe0c0000 0 0x11000>;

                port1 {
                        ranges = <0 0 0xc 0x20000000 0 0x10000000>;
                };
                port2 {
                        ranges = <0 0 0xc 0x30000000 0 0x10000000>;
                };
        };
};
